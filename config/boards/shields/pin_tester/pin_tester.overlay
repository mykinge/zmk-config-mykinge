/ {
    chosen {
        zmk,kscan = &kscan0;
    };

    kscan0: kscan {
        compatible = "zmk,kscan-gpio-direct";
        wakeup-source;

        input-gpios
            = <&gpio0 2 (GPIO_ACTIVE_LOW | GPIO_PULL_UP)>   // Pin 0
            , <&gpio0 3 (GPIO_ACTIVE_LOW | GPIO_PULL_UP)>   // Pin 1
            , <&gpio0 4 (GPIO_ACTIVE_LOW | GPIO_PULL_UP)>   // Pin 2
            , <&gpio0 5 (GPIO_ACTIVE_LOW | GPIO_PULL_UP)>   // Pin 3
            , <&gpio0 6 (GPIO_ACTIVE_LOW | GPIO_PULL_UP)>   // Pin 4
            , <&gpio0 7 (GPIO_ACTIVE_LOW | GPIO_PULL_UP)>   // Pin 5
            , <&gpio0 8 (GPIO_ACTIVE_LOW | GPIO_PULL_UP)>   // Pin 6
            , <&gpio0 11 (GPIO_ACTIVE_LOW | GPIO_PULL_UP)>  // Pin 7
            , <&gpio0 12 (GPIO_ACTIVE_LOW | GPIO_PULL_UP)>  // Pin 8
            , <&gpio0 14 (GPIO_ACTIVE_LOW | GPIO_PULL_UP)>  // Pin 9
            , <&gpio0 15 (GPIO_ACTIVE_LOW | GPIO_PULL_UP)>  // Pin 10
            , <&gpio0 16 (GPIO_ACTIVE_LOW | GPIO_PULL_UP)>  // Pin 11
            , <&gpio0 17 (GPIO_ACTIVE_LOW | GPIO_PULL_UP)>  // Pin 12
            , <&gpio0 20 (GPIO_ACTIVE_LOW | GPIO_PULL_UP)>  // Pin 13
            , <&gpio0 22 (GPIO_ACTIVE_LOW | GPIO_PULL_UP)>  // Pin 14
            , <&gpio0 26 (GPIO_ACTIVE_LOW | GPIO_PULL_UP)>  // Pin 15
            , <&gpio0 29 (GPIO_ACTIVE_LOW | GPIO_PULL_UP)>  // Pin 16
            , <&gpio0 30 (GPIO_ACTIVE_LOW | GPIO_PULL_UP)>  // Pin 17
            , <&gpio0 31 (GPIO_ACTIVE_LOW | GPIO_PULL_UP)>  // Pin 18
            , <&gpio1 1 (GPIO_ACTIVE_LOW | GPIO_PULL_UP)>   // Pin 19
            , <&gpio1 2 (GPIO_ACTIVE_LOW | GPIO_PULL_UP)>   // Pin 20
            , <&gpio1 3 (GPIO_ACTIVE_LOW | GPIO_PULL_UP)>   // Pin 21
            , <&gpio1 4 (GPIO_ACTIVE_LOW | GPIO_PULL_UP)>   // Pin 22
            , <&gpio1 5 (GPIO_ACTIVE_LOW | GPIO_PULL_UP)>   // Pin 23
            , <&gpio1 6 (GPIO_ACTIVE_LOW | GPIO_PULL_UP)>   // Pin 24
            , <&gpio1 7 (GPIO_ACTIVE_LOW | GPIO_PULL_UP)>   // Pin 25
            , <&gpio1 9 (GPIO_ACTIVE_LOW | GPIO_PULL_UP)>   // Pin 26
            , <&gpio1 10 (GPIO_ACTIVE_LOW | GPIO_PULL_UP)>  // Pin 27
            , <&gpio1 11 (GPIO_ACTIVE_LOW | GPIO_PULL_UP)>  // Pin 28
            , <&gpio1 13 (GPIO_ACTIVE_LOW | GPIO_PULL_UP)>  // Pin 29
            , <&gpio1 15 (GPIO_ACTIVE_LOW | GPIO_PULL_UP)>  // Pin 30
            ;
    };
};
